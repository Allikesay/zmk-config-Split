## config/boards/shields/allikecorne/Kconfig.shield
```kconfig
config SHIELD_ALLIKECORNE_LEFT
    def_bool $(shields_list_contains,allikecorne_left)

config SHIELD_ALLIKECORNE_RIGHT
    def_bool $(shields_list_contains,allikecorne_right)
```
